## greenhouse_esp32/sdkconfig.defaults
```kconfig
CONFIG_ESP_MAIN_TASK_STACK_SIZE=8192
CONFIG_HTTPD_MAX_REQ_HDR_LEN=1024
CONFIG_HTTPD_MAX_URI_LEN=512
CONFIG_LWIP_MAX_SOCKETS=8
CONFIG_MBEDTLS_CERTIFICATE_BUNDLE=y
CONFIG_NVS_ENCRYPTION=n
```
